
&spi0 {
    status = "okay";
    compatible = "nordic,nrf-spim";
    pinctrl-0 = <&spi0_default>;
    pinctrl-1 = <&spi0_sleep>;
    pinctrl-names = "default", "sleep";
    cs-gpios = <&gpio0 20 GPIO_ACTIVE_LOW>;

    pointing_device: pointing_device@0 {
        status = "okay";
        compatible = "pixart,paw3222";
        reg = <0>;
        spi-max-frequency = <2000000>;
        irq-gpios = <&gpio0 19 GPIO_ACTIVE_LOW>;
        power-gpios = <&gpio0 8 (GPIO_ACTIVE_HIGH | NRF_GPIO_DRIVE_H0H1)>;
        // CPI を最低値 608 に設定（細かい操作の精度を最大化）
        // PAW3222 ドライバの有効範囲: 608〜4826 (38 刻み)
        // 上げる場合の例: 760 (=20*38), 912 (=24*38), 1216 (=32*38) 等
        res-cpi = <608>;
    };
};
